## firmware/sdkconfig.defaults
```kconfig
# VRC Facial Tracker - ESP-IDF configuration defaults
#
# These settings are applied when building with framework = espidf.

# PSRAM (OPI, 80MHz for XIAO ESP32S3 Sense)
CONFIG_SPIRAM=y
CONFIG_SPIRAM_MODE_OCT=y
CONFIG_SPIRAM_SPEED_80M=y
CONFIG_SPIRAM_USE_MALLOC=y

# Camera driver
CONFIG_CAMERA_TASK_STACK_SIZE=4096

# Partition table
CONFIG_PARTITION_TABLE_CUSTOM=y
CONFIG_PARTITION_TABLE_CUSTOM_FILENAME="partitions.csv"

# Stack size for main task (ESP-WHO models need more stack)
CONFIG_ESP_MAIN_TASK_STACK_SIZE=8192

# Flash size
CONFIG_ESPTOOLPY_FLASHSIZE_8MB=y
```
